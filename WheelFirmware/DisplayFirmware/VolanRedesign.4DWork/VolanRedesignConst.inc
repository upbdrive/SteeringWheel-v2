// File generated 3/15/2022 7:22:14 PM
// Warning! This is a generated file, any manual changes will be
// lost during the next generation.

#constant  Strings1Count    1
#constant  Strings1Size     4
#constant  IFONT_OFFSET     2
// object indexes into ImageControl
#CONST
    iStatictext12   // offset 0x0
    iMeter1         // offset 0x400
    iLeddigits10    // offset 0x149F200
    iiLeddigits10   // offset 0x14A0200
    iForm1          // offset 0x14A3600
    iLeddigits0     // offset 0x14E3400
    iiLeddigits0    // offset 0x14E9600
    iGauge0         // offset 0x1526000
    iStatictext1    // offset 0x1645A00
    iLeddigits1     // offset 0x1646E00
    iiLeddigits1    // offset 0x1649400
    iStatictext2    // offset 0x164DE00
    iLeddigits2     // offset 0x164EC00
    iiLeddigits2    // offset 0x1650600
    iStatictext3    // offset 0x1655A00
    iStatictext4    // offset 0x1656800
    iLeddigits3     // offset 0x1657200
    iiLeddigits3    // offset 0x1657E00
    iStatictext5    // offset 0x165B200
    iStatictext0    // offset 0x165B800
    iForm2          // offset 0x165EE00
    iLeddigits4     // offset 0x169EC00
    iiLeddigits4    // offset 0x16A0A00
    iLeddigits5     // offset 0x16A6800
    iiLeddigits5    // offset 0x16A7C00
    iLeddigits6     // offset 0x16ADA00
    iiLeddigits6    // offset 0x16AEE00
    iStatictext6    // offset 0x16B4C00
    iStatictext7    // offset 0x16B6000
    iStatictext8    // offset 0x16B7600
    iLeddigits7     // offset 0x16B9000
    iiLeddigits7    // offset 0x16BAE00
    iLeddigits8     // offset 0x16C0C00
    iiLeddigits8    // offset 0x16C2A00
    iStatictext9    // offset 0x16C8800
    iStatictext10   // offset 0x16C9600
    iStatictext11   // offset 0x16CA600
    iLeddigits9     // offset 0x16CBC00
    iiLeddigits9    // offset 0x16CDA00
#END

#constant  Strings0Size     0
#constant  Strings0StartH   0
#constant  Strings0StartL   0

#constant  Strings1StartH   0x0
#constant  Strings1StartL   0x0

#IFNOT EXISTS NOGLOBALS
var hndl ;
var hFonts[2] ;
#ENDIF
