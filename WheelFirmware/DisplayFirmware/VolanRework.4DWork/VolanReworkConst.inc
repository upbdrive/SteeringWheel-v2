// File generated 3/12/2022 5:53:24 PM
// Warning! This is a generated file, any manual changes will be
// lost during the next generation.

#constant  Strings0Count    0
#constant  Strings0Size     1
#constant  Strings1Count    0
#constant  Strings1Size     1
#constant  Strings2Count    0
#constant  Strings2Size     1
#constant  Strings3Count    0
#constant  Strings3Size     1
#constant  Strings4Count    0
#constant  Strings4Size     1
#constant  Strings5Count    0
#constant  Strings5Size     1
#constant  Strings6Count    0
#constant  Strings6Size     1
#constant  Strings7Count    0
#constant  Strings7Size     1
#constant  Strings8Count    0
#constant  Strings8Size     1
#constant  Strings9Count    1
#constant  Strings9Size     4
#constant  IFONT_OFFSET     10
// object indexes into ImageControl
#CONST
    iForm1          // offset 0x0
    iStatictext0    // offset 0x3FE00
    iStatictext1    // offset 0x40A00
    iStatictext2    // offset 0x41400
    iLeddigits0     // offset 0x42200
    iiLeddigits0    // offset 0x47400
    iLeddigits1     // offset 0x58800
    iiLeddigits1    // offset 0x5D400
    iLeddigits2     // offset 0x66A00
    iiLeddigits2    // offset 0x68A00
    iStatictext3    // offset 0x7CE00
    iStatictext4    // offset 0x7D600
    iStatictext5    // offset 0x7DE00
    iStatictext6    // offset 0x7E400
    iStatictext7    // offset 0x7EC00
    iStatictext8    // offset 0x7F200
    iUserled0       // offset 0x7F600
    iForm2          // offset 0x80E00
    iLeddigits3     // offset 0xC0C00
    iiLeddigits3    // offset 0xC2A00
    iLeddigits4     // offset 0xC8800
    iiLeddigits4    // offset 0xCA600
    iLeddigits5     // offset 0xD0400
    iiLeddigits5    // offset 0xD2200
    iStatictext9    // offset 0xD8000
    iStatictext10   // offset 0xD9400
    iStatictext11   // offset 0xDAA00
    iStatictext12   // offset 0xDBC00
    iStatictext13   // offset 0xDD400
    iLeddigits6     // offset 0xDE600
    iiLeddigits6    // offset 0xE0400
    iLeddigits7     // offset 0xE6800
    iiLeddigits7    // offset 0xE8600
    iForm3          // offset 0xEEA00
    iMeter0         // offset 0x12E800
    iStatictext14   // offset 0xF83C00
    iGauge0         // offset 0xF85200
    iStatictext15   // offset 0x1029C00
    iForm4          // offset 0x102A000
    iLeddigits8     // offset 0x1069E00
    iiLeddigits8    // offset 0x1070000
    iGauge1         // offset 0x10ACA00
    iStatictext16   // offset 0x11CC400
    iLeddigits9     // offset 0x11CD800
    iiLeddigits9    // offset 0x11CFE00
    iStatictext17   // offset 0x11D4800
    iLeddigits10    // offset 0x11D5600
    iiLeddigits10   // offset 0x11D7000
    iStatictext18   // offset 0x11DC400
#END


#constant  Strings0StartH   0x0
#constant  Strings0StartL   0x0
#constant  Strings1StartH   0x0
#constant  Strings1StartL   0x200
#constant  Strings2StartH   0x0
#constant  Strings2StartL   0x400
#constant  Strings3StartH   0x0
#constant  Strings3StartL   0x600
#constant  Strings4StartH   0x0
#constant  Strings4StartL   0x800
#constant  Strings5StartH   0x0
#constant  Strings5StartL   0xA00
#constant  Strings6StartH   0x0
#constant  Strings6StartL   0xC00
#constant  Strings7StartH   0x0
#constant  Strings7StartL   0xE00
#constant  Strings8StartH   0x0
#constant  Strings8StartL   0x1000
#constant  Strings9StartH   0x0
#constant  Strings9StartL   0x1200

#IFNOT EXISTS NOGLOBALS
var hndl ;
var hFonts[10] ;
#ENDIF
